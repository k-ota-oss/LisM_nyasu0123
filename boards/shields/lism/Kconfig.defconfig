## boards/shields/lism/Kconfig.defconfig
```kconfig
if SHIELD_LISM_LEFT

config ZMK_KEYBOARD_NAME
    default "LisM"

endif

if SHIELD_LISM_RIGHT

config ZMK_KEYBOARD_NAME
    default "LisM"

config ZMK_SPLIT_ROLE_CENTRAL
    default y

endif
```

## config/west.yml
```yaml
manifest:
  remotes:
    - name: zmkfirmware
      url-base: https://github.com/zmkfirmware
    - name: sekigon-gonnoc
      url-base: https://github.com/sekigon-gonnoc
    - name: 4mplelab
      url-base: https://github.com/4mplelab

  projects:
    - name: zmk
      remote: zmkfirmware
      revision: main
      import: app/west.yml

    - name: zmk-driver-paw3222
      remote: sekigon-gonnoc
      revision: main

    - name: zmk-feature-charge-indicator
      remote: 4mplelab
      revision: main

  self:
    path: config
```
