encoder: encoder {
    compatible = "alps,ec11";
    a-gpios = <&gpio0 10 (GPIO_ACTIVE_HIGH | GPIO_PULL_UP)>;
    b-gpios = <&xiao_d 6 (GPIO_ACTIVE_HIGH | GPIO_PULL_UP)>;
    steps = <12>;
    status = "okay";
};

sensors: sensors {
    compatible = "zmk,keymap-sensors";
    sensors = <&encoder>;
    triggers-per-rotation = <12>;
};
